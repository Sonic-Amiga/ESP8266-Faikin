## main/Kconfig
```kconfig
menu "Faikin"
  
choice FAIKIN_AC_UART_NUM_SEL
    prompt "UART port for AC communication"
    default FAIKIN_AC_UART_NUM_0
    help
        Serial port to use for communication with the conditioner

    config FAIKIN_AC_UART_NUM_0
        bool "UART_NUM_0"
    config FAIKIN_AC_UART_NUM_1
        bool "UART_NUM_1"
    config FAIKIN_AC_UART_NONE
        bool "None"
		help
		    This option selects running with a mock AC and no serial communication.
			Use it for development and interface testing.

endchoice

config FAIKIN_AC_UART_NUM
    int
    default 0 if FAIKIN_AC_UART_NUM_0
    default 1 if FAIKIN_AC_UART_NUM_1
	default 255 if FAIKIN_AC_UART_NONE

endmenu
```
